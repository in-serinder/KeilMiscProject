#include "ssd13xx.h"
#include <intrins.h>

// 单页缓冲区（仅128字节）
unsigned char xdata SSD13XX_PageBuffer[SSD13XX_PAGE_WIDTH];

const unsigned char code SSD13xx_Font8x8[95][8] = {
    {0x00, 0x00, 0x00, 0x00, 0x00, 0x00, 0x00, 0x00}, // 空格
    {0x00, 0x00, 0x5F, 0x00, 0x00, 0x00, 0x00, 0x00}, // !
    {0x00, 0x00, 0x07, 0x00, 0x07, 0x00, 0x00, 0x00}, // "
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    {0x00, 0x02, 0x01, 0x02, 0x04, 0x02, 0x00, 0x00}  // ~
};

// 16x16 ASCII字体库 (仅包含常用字符) - 放在CODE段
// const unsigned char xdata SSD13xx_Font16x16[96][16] = {
//     {0x00, 0x00, 0x00, 0x00, 0x00, 0x00, 0x00, 0x00, 0x00, 0x00, 0x00, 0x00,
//      0x00, 0x00, 0x00, 0x00}, // 空格
//     {0x00, 0x00, 0x00, 0x00, 0x00, 0x00, 0x00, 0x00, 0x00, 0x00, 0x00, 0x00,
//      0x00, 0x00, 0x00, 0x00}, // !
//     {0x00, 0x00, 0x00, 0x00, 0x00, 0x00, 0x00, 0x00, 0x00, 0x00, 0x00, 0x00,
//      0x00, 0x00, 0x00, 0x00}, // "
//     {0x00, 0x00, 0x00, 0x00, 0x00, 0x00, 0x00, 0x00, 0x00, 0x00, 0x00, 0x00,
//      0x00, 0x00, 0x00, 0x00}, // #
//     {0x00, 0x00, 0x00, 0x00, 0x00, 0x00, 0x00, 0x00, 0x00, 0x00, 0x00, 0x00,
//      0x00, 0x00, 0x00, 0x00}, // $
//     {0x00, 0x00, 0x00, 0x00, 0x00, 0x00, 0x00, 0x00, 0x00, 0x00, 0x00, 0x00,
//      0x00, 0x00, 0x00, 0x00}, // %
//     {0x00, 0x00, 0x00, 0x00, 0x00, 0x00, 0x00, 0x00, 0x00, 0x00, 0x00, 0x00,
//      0x00, 0x00, 0x00, 0x00}, // &
//     {0x00, 0x00, 0x00, 0x00, 0x00, 0x00, 0x00, 0x00, 0x00, 0x00, 0x00, 0x00,
//      0x00, 0x00, 0x00, 0x00}, // '
//     {0x00, 0x00, 0x00, 0x00, 0x00, 0x00, 0x00, 0x00, 0x00, 0x00, 0x00, 0x00,
//      0x00, 0x00, 0x00, 0x00}, // (
//     {0x00, 0x00, 0x00, 0x00, 0x00, 0x00, 0x00, 0x00, 0x00, 0x00, 0x00, 0x00,
//      0x00, 0x00, 0x00, 0x00}, // )
//     {0x00, 0x00, 0x00, 0x00, 0x00, 0x00, 0x00, 0x00, 0x00, 0x00, 0x00, 0x00,
//      0x00, 0x00, 0x00, 0x00}, // *
//     {0x00, 0x00, 0x00, 0x00, 0x00, 0x00, 0x00, 0x00, 0x00, 0x00, 0x00, 0x00,
//      0x00, 0x00, 0x00, 0x00}, // +
//     {0x00, 0x00, 0x00, 0x00, 0x00, 0x00, 0x00, 0x00, 0x00, 0x00, 0x00, 0x00,
//      0x00, 0x00, 0x00, 0x00}, // ,
//     {0x00, 0x00, 0x00, 0x00, 0x00, 0x00, 0x00, 0x00, 0x00, 0x00, 0x00, 0x00,
//      0x00, 0x00, 0x00, 0x00}, // -
//     {0x00, 0x00, 0x00, 0x00, 0x00, 0x00, 0x00, 0x00, 0x00, 0x00, 0x00, 0x00,
//      0x00, 0x00, 0x00, 0x00}, // .
//     {0x00, 0x00, 0x00, 0x00, 0x00, 0x00, 0x00, 0x00, 0x00, 0x00, 0x00, 0x00,
//      0x00, 0x00, 0x00, 0x00}, // /
//     {0x00, 0x00, 0x7E, 0xFF, 0xFF, 0xFF, 0xFF, 0xFF, 0xFF, 0xFF, 0xFF, 0xFF,
//      0xFF, 0x7E, 0x00, 0x00}, // 0
//     {0x00, 0x00, 0x40, 0x42, 0x44, 0x48, 0x50, 0x40, 0x40, 0x40, 0x40, 0x40,
//      0x7F, 0x40, 0x00, 0x00}, // 1
//     {0x00, 0x00, 0x7F, 0xFF, 0xFF, 0x01, 0x02, 0x04, 0x08, 0x10, 0x20, 0x40,
//      0xFF, 0xFF, 0x00, 0x00}, // 2
//     {0x00, 0x00, 0x7F, 0xFF, 0xFF, 0x01, 0x02, 0x04, 0x08, 0x01, 0x02, 0xFF,
//      0xFF, 0x7E, 0x00, 0x00}, // 3
//     {0x00, 0x00, 0x08, 0x18, 0x28, 0x48, 0x88, 0x08, 0x08, 0xFF, 0xFF, 0xFF,
//      0xFF, 0x08, 0x00, 0x00}, // 4
//     {0x00, 0x00, 0xFF, 0xFF, 0xFF, 0x80, 0x40, 0x20, 0x10, 0x01, 0x02, 0xFF,
//      0xFF, 0x7E, 0x00, 0x00}, // 5
//     {0x00, 0x00, 0x3E, 0x7C, 0xFC, 0x80, 0x40, 0x20, 0x10, 0x01, 0x02, 0xFF,
//      0xFF, 0x7E, 0x00, 0x00}, // 6
//     {0x00, 0x00, 0xFF, 0xFF, 0xFF, 0x01, 0x02, 0x04, 0x08, 0x10, 0x20, 0x40,
//      0x40, 0x40, 0x00, 0x00}, // 7
//     {0x00, 0x00, 0x7E, 0xFF, 0xFF, 0x41, 0x22, 0x14, 0x08, 0x14, 0x22, 0xFF,
//      0xFF, 0x7E, 0x00, 0x00}, // 8
//     {0x00, 0x00, 0x7E, 0xFF, 0xFF, 0x41, 0x22, 0x14, 0x08, 0x04, 0x02, 0xFE,
//      0xFE, 0x7C, 0x00, 0x00}, // 9
//     {0x00, 0x00, 0x00, 0x00, 0x00, 0x00, 0x00, 0x00, 0x00, 0x00, 0x00, 0x00,
//      0x00, 0x00, 0x00, 0x00}, // :
//     {0x00, 0x00, 0x00, 0x00, 0x00, 0x00, 0x00, 0x00, 0x00, 0x00, 0x00, 0x00,
//      0x00, 0x00, 0x00, 0x00}, // ;
//     {0x00, 0x00, 0x00, 0x00, 0x00, 0x00, 0x00, 0x00, 0x00, 0x00, 0x00, 0x00,
//      0x00, 0x00, 0x00, 0x00}, // <
//     {0x00, 0x00, 0x00, 0x00, 0x00, 0x00, 0x00, 0x00, 0x00, 0x00, 0x00, 0x00,
//      0x00, 0x00, 0x00, 0x00}, // =
//     {0x00, 0x00, 0x00, 0x00, 0x00, 0x00, 0x00, 0x00, 0x00, 0x00, 0x00, 0x00,
//      0x00, 0x00, 0x00, 0x00}, // >
//     {0x00, 0x00, 0x00, 0x00, 0x00, 0x00, 0x00, 0x00, 0x00, 0x00, 0x00, 0x00,
//      0x00, 0x00, 0x00, 0x00}, // ?
//     {0x00, 0x00, 0x00, 0x00, 0x00, 0x00, 0x00, 0x00, 0x00, 0x00, 0x00, 0x00,
//      0x00, 0x00, 0x00, 0x00}, // @
//     {0x00, 0x00, 0x00, 0x7E, 0xFF, 0xFF, 0xC3, 0xC3, 0xFF, 0xFF, 0xFF, 0xFF,
//      0xFF, 0x7E, 0x00, 0x00}, // A
//     {0x00, 0x00, 0x80, 0xFF, 0xFF, 0xFF, 0xFF, 0x80, 0x80, 0x80, 0x80, 0x80,
//      0xFF, 0xFF, 0x00, 0x00}, // B
//     {0x00, 0x00, 0x3E, 0xFF, 0xFF, 0x81, 0x81, 0x81, 0x81, 0x81, 0x81, 0xFF,
//      0xFF, 0x3E, 0x00, 0x00}, // C
//     {0x00, 0x00, 0x01, 0xFF, 0xFF, 0xFF, 0xFF, 0x81, 0x81, 0x81, 0x81, 0xFF,
//      0xFF, 0x01, 0x00, 0x00}, // D
//     {0x00, 0x00, 0xFF, 0xFF, 0xFF, 0x81, 0x81, 0xFF, 0x81, 0x81, 0x81, 0xFF,
//      0xFF, 0xFF, 0x00, 0x00}, // E
//     {0x00, 0x00, 0xFF, 0xFF, 0xFF, 0x81, 0x81, 0xFF, 0x81, 0x81, 0x81, 0x81,
//      0x81, 0x81, 0x00, 0x00}, // F
//     {0x00, 0x00, 0x3E, 0xFF, 0xFF, 0x81, 0x81, 0x81, 0x81, 0x81, 0x91, 0xFF,
//      0xFF, 0xBE, 0x00, 0x00}, // G
//     {0x00, 0x00, 0xFF, 0xFF, 0xFF, 0x08, 0x08, 0xFF, 0xFF, 0xFF, 0xFF, 0xFF,
//      0xFF, 0xFF, 0x00, 0x00}, // H
//     {0x00, 0x00, 0x00, 0x00, 0x81, 0x81, 0xFF, 0xFF, 0xFF, 0xFF, 0x81, 0x81,
//      0x00, 0x00, 0x00, 0x00}, // I
//     {0x00, 0x00, 0x00, 0x00, 0x81, 0x81, 0x81, 0x81, 0x81, 0x81, 0xFF, 0xFF,
//      0x01, 0x00, 0x00, 0x00}, // J
//     {0x00, 0x00, 0xFF, 0xFF, 0xFF, 0x08, 0x14, 0x22, 0x41, 0x80, 0x00, 0xFF,
//      0xFF, 0xFF, 0x00, 0x00}, // K
//     {0x00, 0x00, 0xFF, 0xFF, 0xFF, 0x80, 0x80, 0x80, 0x80, 0x80, 0x80, 0x80,
//      0x80, 0x80, 0x00, 0x00}, // L
//     {0x00, 0x00, 0xFF, 0xFF, 0xFF, 0x03, 0x0C, 0x30, 0x0C, 0x03, 0xFF, 0xFF,
//      0xFF, 0xFF, 0x00, 0x00}, // M
//     {0x00, 0x00, 0xFF, 0xFF, 0xFF, 0x03, 0x0C, 0x30, 0xC0, 0x00, 0xFF, 0xFF,
//      0xFF, 0xFF, 0x00, 0x00}, // N
//     {0x00, 0x00, 0x3E, 0xFF, 0xFF, 0x81, 0x81, 0x81, 0x81, 0x81, 0x81, 0xFF,
//      0xFF, 0x3E, 0x00, 0x00}, // O
//     {0x00, 0x00, 0xFF, 0xFF, 0xFF, 0x81, 0x81, 0xFF, 0x81, 0x81, 0x81, 0x81,
//      0x81, 0x81, 0x00, 0x00}, // P
//     {0x00, 0x00, 0x3E, 0xFF, 0xFF, 0x81, 0x81, 0x81, 0x81, 0x81, 0x81, 0xFF,
//      0xFF, 0xFE, 0x00, 0x00}, // Q
//     {0x00, 0x00, 0xFF, 0xFF, 0xFF, 0x81, 0x81, 0xFF, 0x81, 0x91, 0xA1, 0xC1,
//      0xE1, 0x01, 0x00, 0x00}, // R
//     {0x00, 0x00, 0x00, 0xBE, 0xFF, 0xFF, 0x41, 0x22, 0x14, 0x08, 0x08, 0xFF,
//      0xFF, 0x7E, 0x00, 0x00}, // S
//     {0x00, 0x00, 0x01, 0x01, 0x01, 0x01, 0x01, 0xFF, 0xFF, 0xFF, 0x01, 0x01,
//      0x01, 0x01, 0x00, 0x00}, // T
//     {0x00, 0x00, 0xFF, 0xFF, 0xFF, 0x80, 0x80, 0x80, 0x80, 0x80, 0x80, 0xFF,
//      0xFF, 0xFF, 0x00, 0x00}, // U
//     {0x00, 0x00, 0x1F, 0x3F, 0x7F, 0xC0, 0xC0, 0xC0, 0xC0, 0xC0, 0xC0, 0x7F,
//      0x3F, 0x1F, 0x00, 0x00}, // V
//     {0x00, 0x00, 0xFF, 0xFF, 0xFF, 0x00, 0x00, 0xFC, 0x00, 0x00, 0xFF, 0xFF,
//      0xFF, 0xFF, 0x00, 0x00}, // W
//     {0x00, 0x00, 0xE1, 0xF3, 0xDB, 0x6E, 0x3C, 0x18, 0x3C, 0x6E, 0xDB, 0xF3,
//      0xE1, 0x00, 0x00, 0x00}, // X
//     {0x00, 0x00, 0x07, 0x0F, 0x1F, 0xE0, 0xE0, 0xE0, 0xE0, 0xE0, 0xE0, 0x1F,
//      0x0F, 0x07, 0x00, 0x00}, // Y
//     {0x00, 0x00, 0xC1, 0xE3, 0xF7, 0xFF, 0x1F, 0x0E, 0x0C, 0x08, 0x00, 0xFF,
//      0xFF, 0xFF, 0x00, 0x00}, // Z
//     {0x00, 0x00, 0x00, 0x00, 0xFF, 0xFF, 0x81, 0x81, 0x81, 0x81, 0xFF, 0xFF,
//      0x00, 0x00, 0x00, 0x00}, // [
//     {0x00, 0x00, 0x00, 0x00, 0x00, 0x00, 0x00, 0x00, 0x00, 0x00, 0x00, 0x00,
//      0x00, 0x00, 0x00, 0x00}, // \
//     {0x00,0x00,0x00,0x00,0xFF,0xFF,0x81,0x81,0x81,0x81,0xFF,0xFF,0x00,0x00,0x00,0x00},
//     // ] {0x00, 0x00, 0x00, 0x00, 0x00, 0x00, 0x00, 0x00, 0x00, 0x00, 0x00,
//     0x00,
//      0x00, 0x00, 0x00, 0x00}, // ^
//     {0x00, 0x00, 0x00, 0x00, 0x00, 0x00, 0x00, 0x00, 0x00, 0x00, 0x00, 0x00,
//      0x00, 0x00, 0x00, 0x00}, // _
//     {0x00, 0x00, 0x00, 0x00, 0x00, 0x00, 0x00, 0x00, 0x00, 0x00, 0x00, 0x00,
//      0x00, 0x00, 0x00, 0x00}, // `
//     {0x00, 0x00, 0x00, 0x00, 0x00, 0x7C, 0xFE, 0xFE, 0x7C, 0x00, 0x00, 0xFF,
//      0xFF, 0xFF, 0x00, 0x00}, // a
//     {0x00, 0x00, 0x80, 0x80, 0x80, 0xFC, 0xFE, 0xFE, 0xFE, 0x80, 0x80, 0xFF,
//      0xFF, 0xFF, 0x00, 0x00}, // b
//     {0x00, 0x00, 0x00, 0x00, 0x00, 0x7C, 0xFE, 0xFE, 0xFE, 0x82, 0x82, 0x82,
//      0x82, 0x00, 0x00, 0x00}, // c
//     {0x00, 0x00, 0x02, 0x02, 0x02, 0x82, 0xFE, 0xFE, 0xFE, 0xFC, 0x00, 0xFF,
//      0xFF, 0xFF, 0x00, 0x00}, // d
//     {0x00, 0x00, 0x00, 0x00, 0x00, 0x7C, 0xFE, 0xFE, 0xFE, 0x82, 0x82, 0xBE,
//      0xFE, 0x7C, 0x00, 0x00}, // e
//     {0x00, 0x00, 0x00, 0x00, 0x00, 0x3E, 0x7F, 0x7F, 0x03, 0x00, 0x00, 0xFF,
//      0xFF, 0xFF, 0x00, 0x00}, // f
//     {0x00, 0x00, 0x00, 0x00, 0x00, 0x7C, 0xFE, 0xFE, 0xFE, 0x82, 0x82, 0xFC,
//      0xFE, 0x7C, 0x00, 0x00}, // g
//     {0x00, 0x00, 0x80, 0x80, 0x80, 0xFC, 0xFE, 0xFE, 0xFE, 0x0C, 0x04, 0xFF,
//      0xFF, 0xFF, 0x00, 0x00}, // h
//     {0x00, 0x00, 0x00, 0x00, 0x00, 0x00, 0x82, 0xFF, 0xFF, 0x82, 0x00, 0x00,
//      0xFF, 0xFF, 0x00, 0x00}, // i
//     {0x00, 0x00, 0x00, 0x00, 0x00, 0x00, 0x82, 0xFF, 0xFF, 0x82, 0x82, 0x82,
//      0xFF, 0xFF, 0x02, 0x00}, // j
//     {0x00, 0x00, 0x80, 0x80, 0x80, 0xFC, 0xFE, 0xFE, 0xFE, 0x18, 0x24, 0xFF,
//      0xFF, 0xFF, 0x00, 0x00}, // k
//     {0x00, 0x00, 0x00, 0x00, 0x00, 0x00, 0x82, 0xFF, 0xFF, 0x82, 0x82, 0x82,
//      0x82, 0x82, 0x00, 0x00}, // l
//     {0x00, 0x00, 0x00, 0x00, 0x00, 0xFF, 0xFF, 0xFF, 0x00, 0x00, 0xFF, 0xFF,
//      0xFF, 0xFF, 0x00, 0x00}, // m
//     {0x00, 0x00, 0x00, 0x00, 0x00, 0xFF, 0xFF, 0xFF, 0x00, 0x00, 0xFF, 0xFF,
//      0xFF, 0xFF, 0x00, 0x00}, // n
//     {0x00, 0x00, 0x00, 0x00, 0x00, 0x7C, 0xFE, 0xFE, 0xFE, 0x82, 0x82, 0x82,
//      0x82, 0x00, 0x00, 0x00}, // o
//     {0x00, 0x00, 0x00, 0x00, 0x00, 0xFF, 0xFF, 0xFF, 0x00, 0x00, 0x82, 0x82,
//      0x82, 0x82, 0x00, 0x00}, // p
//     {0x00, 0x00, 0x00, 0x00, 0x00, 0xFF, 0xFF, 0xFF, 0x00, 0x00, 0x82, 0x82,
//      0xFC, 0xFE, 0x7C, 0x00}, // q
//     {0x00, 0x00, 0x00, 0x00, 0x00, 0xFF, 0xFF, 0xFF, 0x00, 0x00, 0x0C, 0x04,
//      0xFF, 0xFF, 0xFF, 0x00}, // r
//     {0x00, 0x00, 0x00, 0x00, 0x00, 0x7C, 0xFE, 0xFE, 0xFE, 0x82, 0x82, 0xBE,
//      0xFE, 0x7C, 0x00, 0x00}, // s
//     {0x00, 0x00, 0x00, 0x00, 0x00, 0x00, 0x82, 0xFF, 0xFF, 0x82, 0x82, 0x82,
//      0x82, 0x82, 0x00, 0x00}, // t
//     {0x00, 0x00, 0x00, 0x00, 0x00, 0xFF, 0xFF, 0xFF, 0x80, 0x80, 0xFF, 0xFF,
//      0xFF, 0xFF, 0x00, 0x00}, // u
//     {0x00, 0x00, 0x00, 0x00, 0x00, 0x1F, 0x3F, 0x7F, 0xE0, 0xE0, 0xE0, 0x7F,
//      0x3F, 0x1F, 0x00, 0x00}, // v
//     {0x00, 0x00, 0x00, 0x00, 0x00, 0xFF, 0xFF, 0xFF, 0x00, 0x00, 0xFF, 0xFF,
//      0xFF, 0xFF, 0x00, 0x00}, // w
//     {0x00, 0x00, 0x00, 0x00, 0x00, 0xE1, 0xF3, 0xDB, 0x6E, 0x3C, 0x18, 0x3C,
//      0x6E, 0xDB, 0x00, 0x00}, // x
//     {0x00, 0x00, 0x00, 0x00, 0x00, 0x07, 0x0F, 0x1F, 0xE0, 0xE0, 0xE0, 0xFE,
//      0xFE, 0x7C, 0x00, 0x00}, // y
//     {0x00, 0x00, 0x00, 0x00, 0x00, 0xC1, 0xE3, 0xF7, 0xFF, 0x1F, 0x0E, 0x0C,
//      0x08, 0x00, 0x00, 0x00}, // z
//     {0x00, 0x00, 0x00, 0x00, 0x00, 0x00, 0x00, 0x00, 0x00, 0x00, 0x00, 0x00,
//      0x00, 0x00, 0x00, 0x00}, // {
//     {0x00, 0x00, 0x00, 0x00, 0x00, 0x00, 0x00, 0x00, 0x00, 0x00, 0x00, 0x00,
//      0x00, 0x00, 0x00, 0x00}, // |
//     {0x00, 0x00, 0x00, 0x00, 0x00, 0x00, 0x00, 0x00, 0x00, 0x00, 0x00, 0x00,
//      0x00, 0x00, 0x00, 0x00}, // }
//     {0x00, 0x00, 0x00, 0x00, 0x00, 0x00, 0x00, 0x00, 0x00, 0x00, 0x00, 0x00,
//      0x00, 0x00, 0x00, 0x00} // ~
// };

// ==================== I2C 底层函数 ====================
void I2C_Init(void) {
  SDA = 1;
  SCL = 1;
}

void I2C_Delay(void) {
  unsigned char i = 1;
  while (i--)
    ;
}

void I2C_Start(void) {
  SDA = 1;
  SCL = 1;
  I2C_Delay();
  SDA = 0;
  I2C_Delay();
  SCL = 0;
}

void I2C_Stop(void) {
  SDA = 0;
  SCL = 1;
  I2C_Delay();
  SDA = 1;
  I2C_Delay();
}

void I2C_SendByte(unsigned char byte) {
  unsigned char xdata i;
  for (i = 0; i < 8; i++) {
    SDA = (byte & 0x80) >> 7;
    byte <<= 1;
    SCL = 1;
    I2C_Delay();
    SCL = 0;
    I2C_Delay();
  }
  SDA = 1;
  I2C_Delay();
}

bit I2C_WaitAck(void) {
  bit ack;
  SDA = 1;
  I2C_Delay();
  SCL = 1;
  I2C_Delay();
  ack = SDA;
  SCL = 0;
  I2C_Delay();
  return ack;
}

//================ SSD13XX 基本命令/数据 ====================
/***************************************************************************************************
 * 函数名: SSD13XX_WriteCommand
 * 描述: 向SSD13XX发送命令
 * 输入: command - 要发送的命令字节
 * 输出: 无
 * 返回: 无
 * 注意: 使用I2C接口发送命令，控制字节标识为命令类型
 **************************************************************************************************/
void SSD13XX_WriteCommand(unsigned char command) {
  I2C_Start();
  I2C_SendByte(SSD13XX_I2C_ADDRESS << 1); // 发送器件地址+W
  I2C_WaitAck();
  I2C_SendByte(SSD13XX_CONTROL_BYTE_CMD_SINGLE); // 控制字节，表示后面是命令
  I2C_WaitAck();
  I2C_SendByte(command); // 发送命令
  I2C_WaitAck();
  I2C_Stop();
}

/***************************************************************************************************
 * 函数名: SSD13XX_WriteData
 * 描述: 向SSD13XX发送数据
 * 输入: dat - 要发送的数据字节
 * 输出: 无
 * 返回: 无
 * 注意: 使用I2C接口发送数据，控制字节标识为数据类型
 **************************************************************************************************/
void SSD13XX_WriteData(unsigned char dat) {
  I2C_Start();
  I2C_SendByte(SSD13XX_I2C_ADDRESS << 1); // 发送器件地址+W
  I2C_WaitAck();
  I2C_SendByte(SSD13XX_CONTROL_BYTE_DATA_STREAM); // 控制字节，表示后面是数据
  I2C_WaitAck();
  I2C_SendByte(dat); // 发送数据
  I2C_WaitAck();
  I2C_Stop();
}

// ==================== 页管理 ====================
/***************************************************************************************************
 * 函数名: SSD13XX_FlushPage
 * 描述: 将单页缓冲区内容刷新到指定页面
 * 输入: page - 要刷新的页号(0-7)
 * 输出: 无
 * 返回: 无
 * 注意: 将xdata区域的缓冲区内容发送到OLED显示屏的指定页
 **************************************************************************************************/
void SSD13XX_FlushPage(unsigned char page) {
  unsigned char xdata col;
  SSD13XX_WriteCommand(0xB0 | page);
  SSD13XX_WriteCommand(0x00);
  SSD13XX_WriteCommand(0x10);
  for (col = 0; col < SSD13XX_PAGE_WIDTH; col++) {
    SSD13XX_WriteData(SSD13XX_PageBuffer[col]);
  }
}

/***************************************************************************************************
 * 函数名: SSD13XX_ClearPage
 * 描述: 清空指定页面
 * 输入: page - 要清空的页号(0-7)
 * 输出: 无
 * 返回: 无
 * 注意: 将缓冲区清零后刷新到指定页面
 **************************************************************************************************/
void SSD13XX_ClearPage(unsigned char page) {
  unsigned char xdata i;
  for (i = 0; i < SSD13XX_PAGE_WIDTH; i++)
    SSD13XX_PageBuffer[i] = 0x00;
  SSD13XX_FlushPage(page);
}

/***************************************************************************************************
 * 函数名: SSD13XX_Clear
 * 描述: 清空整个显示屏
 * 输入: 无
 * 输出: 无
 * 返回: 无
 * 注意: 依次清空所有8个页面
 **************************************************************************************************/
void SSD13XX_Clear(void) {
  unsigned char xdata page;
  for (page = 0; page < SSD13XX_PAGE_NUM; page++) {
    SSD13XX_ClearPage(page);
  }
}

// ==================== 内部辅助函数 ====================
/***************************************************************************************************
 * 函数名: _DrawPixelOnPage
 * 描述: 在当前页缓冲区中绘制单个像素点（内部函数）
 * 输入: x - 像素点X坐标(0-127)
 *       y_in_page - 像素点在页内的Y坐标(0-7)
 *       color - 像素颜色(0=黑色/关闭, 1=白色/点亮)
 * 输出: 无
 * 返回: 无
 * 注意: 这是一个内部辅助函数，直接操作缓冲区
 **************************************************************************************************/
static void _DrawPixelOnPage(unsigned char x, unsigned char y_in_page,
                             unsigned char color) {
  unsigned char mask;
  if (x >= SSD13XX_WIDTH || y_in_page >= 8)
    return;
  mask = 1 << y_in_page;
  if (color)
    SSD13XX_PageBuffer[x] |= mask;
  else
    SSD13XX_PageBuffer[x] &= ~mask;
}

// ==================== 图形绘制 ====================
/***************************************************************************************************
 * 函数名: SSD13XX_DrawPixel
 * 描述: 在指定坐标绘制单个像素点
 * 输入: x - 像素点X坐标(0-127)
 *       y - 像素点Y坐标(0-63)
 *       color - 像素颜色(0=黑色/关闭, 1=白色/点亮)
 * 输出: 无
 * 返回: 无
 * 注意: 自动计算像素所属页面并刷新该页面
 **************************************************************************************************/
void SSD13XX_DrawPixel(unsigned char x, unsigned char y, unsigned char color) {
  unsigned char xdata page, row, i;
  page = y / 8;
  row = y % 8;
  for (i = 0; i < SSD13XX_PAGE_WIDTH; i++)
    SSD13XX_PageBuffer[i] = 0x00;
  _DrawPixelOnPage(x, row, color);
  SSD13XX_FlushPage(page);
}

/***************************************************************************************************
 * 函数名: SSD13XX_DrawLine
 * 描述: 绘制一条直线
 * 输入: x1, y1 - 起始点坐标
 *       x2, y2 - 结束点坐标
 *       color - 线条颜色(0=黑色/关闭, 1=白色/点亮)
 * 输出: 无
 * 返回: 无
 * 注意: 使用Bresenham算法绘制直线，自动处理跨页情况
 **************************************************************************************************/
void SSD13XX_DrawLine(unsigned char x1, unsigned char y1, unsigned char x2,
                      unsigned char y2, unsigned char color) {
  int idata dx, dy, stepX, stepY, err, x, y;
  unsigned char idata currentPage, row, page, i;
  dx = (x2 > x1) ? (x2 - x1) : (x1 - x2);
  dy = (y2 > y1) ? (y2 - y1) : (y1 - y2);
  stepX = (x2 >= x1) ? 1 : -1;
  stepY = (y2 >= y1) ? 1 : -1;
  err = dx - dy;
  x = x1;
  y = y1;
  currentPage = y / 8;
  for (i = 0; i < SSD13XX_PAGE_WIDTH; i++)
    SSD13XX_PageBuffer[i] = 0x00;

  while (1) {
    page = y / 8;
    row = y % 8;
    if (page != currentPage) {
      SSD13XX_FlushPage(currentPage);
      for (i = 0; i < SSD13XX_PAGE_WIDTH; i++)
        SSD13XX_PageBuffer[i] = 0x00;
      currentPage = page;
    }
    _DrawPixelOnPage(x, row, color);
    if (x == x2 && y == y2)
      break;
    if (err * 2 > -dy) {
      err -= dy;
      x += stepX;
    }
    if (err * 2 < dx) {
      err += dx;
      y += stepY;
    }
  }
  SSD13XX_FlushPage(currentPage);
}

/***************************************************************************************************
 * 函数名: SSD13XX_DrawRectangle
 * 描述: 绘制一个矩形框
 * 输入: x1, y1 - 矩形左上角坐标
 *       x2, y2 - 矩形右下角坐标
 *       color - 矩形线条颜色(0=黑色/关闭, 1=白色/点亮)
 * 输出: 无
 * 返回: 无
 * 注意: 绘制矩形的四条边，不填充内部
 **************************************************************************************************/
void SSD13XX_DrawRectangle(unsigned char x1, unsigned char y1, unsigned char x2,
                           unsigned char y2, unsigned char color) {
  SSD13XX_DrawLine(x1, y1, x2, y1, color);
  SSD13XX_DrawLine(x2, y1, x2, y2, color);
  SSD13XX_DrawLine(x1, y2, x2, y2, color);
  SSD13XX_DrawLine(x1, y1, x1, y2, color);
}

/***************************************************************************************************
 * 函数名: SSD13XX_DrawCircle
 * 描述: 绘制一个圆形
 * 输入: x0, y0 - 圆心坐标
 *       r - 圆的半径
 *       color - 圆形线条颜色(0=黑色/关闭, 1=白色/点亮)
 * 输出: 无
 * 返回: 无
 * 注意: 使用中点圆算法绘制圆形，不填充内部
 **************************************************************************************************/
void SSD13XX_DrawCircle(unsigned char x0, unsigned char y0, unsigned char r,
                        unsigned char color) {
  int idata x = 0, y = r, d = 3 - 2 * r;
  while (x <= y) {
    SSD13XX_DrawPixel(x0 + x, y0 + y, color);
    SSD13XX_DrawPixel(x0 + x, y0 - y, color);
    SSD13XX_DrawPixel(x0 - x, y0 + y, color);
    SSD13XX_DrawPixel(x0 - x, y0 - y, color);
    SSD13XX_DrawPixel(x0 + y, y0 + x, color);
    SSD13XX_DrawPixel(x0 + y, y0 - x, color);
    SSD13XX_DrawPixel(x0 - y, y0 + x, color);
    SSD13XX_DrawPixel(x0 - y, y0 - x, color);
    if (d < 0)
      d += 4 * x + 6;
    else {
      d += 4 * (x - y) + 10;
      y--;
    }
    x++;
  }
}

/***************************************************************************************************
 * 函数名: SSD13XX_DrawBitmap
 * 描述: 在指定位置绘制位图
 * 输入: x, y - 位图绘制起始坐标
 *       bitmap - 位图数据指针
 *       width - 位图宽度(像素)
 *       height - 位图高度(像素)
 * 输出: 无
 * 返回: 无
 * 注意: 支持跨页绘制，按页为单位处理位图数据
 **************************************************************************************************/
void SSD13XX_DrawBitmap(unsigned char x, unsigned char y,
                        const unsigned char *bitmap, unsigned char width,
                        unsigned char height) {
  unsigned char page, col, row, dat;
  unsigned int offset = 0;
  for (page = 0; page < (height + 7) / 8; page++) {
    for (col = 0; col < width; col++) {
      if (x + col >= SSD13XX_WIDTH || y + page * 8 >= SSD13XX_HEIGHT) {
        offset++;
        continue;
      }
      dat = bitmap[offset++];
      for (row = 0; row < 8; row++) {
        if (y + page * 8 + row >= SSD13XX_HEIGHT)
          break;
        if (dat & (1 << row)) {
          SSD13XX_DrawPixel(x + col, y + page * 8 + row, 1);
        }
      }
    }
  }
}

// ==================== 文本显示 ====================
// void SSD1315_WriteChar(unsigned char x, unsigned char y, char c,
//                        FontSize size) {
//   unsigned char page, col, i;
//   const unsigned char *font;
//   if (size != FONT_8X8)
//     return;
//   if (y % 8 != 0)
//     return;
//   if (c < ' ' || c > '~')
//     c = ' ';
//   page = y / 8;
//   col = x;
//   font = SSD1315_Font8x8[c - ' '];

//   SSD1315_WriteCommand(0xB0 | page);
//   SSD1315_WriteCommand(col & 0x0F);
//   SSD1315_WriteCommand(0x10 | (col >> 4));
//   for (i = 0; i < 8; i++) {
//     SSD1315_WriteData(font[i]);
//   }
// }
/***************************************************************************************************
 * 函数名: SSD13XX_WriteChar
 * 描述: 在指定位置显示单个字符
 * 输入: x, y - 字符显示起始坐标
 *       c - 要显示的字符
 *       size - 字符大小(FONT_8X8或FONT_16X16)
 * 输出: 无
 * 返回: 无
 * 注意: 支持8x8和16x16两种字体大小，自动处理跨页显示
 **************************************************************************************************/
void SSD13XX_WriteChar(unsigned char x, unsigned char y, char c,
                       FontSize size) {
  unsigned char page, col, i;
  const unsigned char *font;
  if (c < ' ' || c > '~')
    c = ' ';

  if (size == FONT_8X8) {
    if (y % 8 != 0)
      return; // 必须页对齐
    page = y / 8;
    col = x;
    font = SSD13xx_Font8x8[c - ' '];
    SSD13XX_WriteCommand(0xB0 | page);
    SSD13XX_WriteCommand(col & 0x0F);
    SSD13XX_WriteCommand(0x10 | (col >> 4));
    for (i = 0; i < 8; i++) {
      SSD13XX_WriteData(font[i]);
    }
  } else if (size == FONT_16X16) {
    if (y % 8 != 0)
      return; // 16x16 也要求页对齐，避免跨更多页
    page = y / 8;
    col = x;
    // font = SSD13xx_Font16x16[c - ' '];
    font = SSD13xx_Font8x8[c - ' '];
    // 失能16x16字体，使用8x8字体显示 优化空间
    //  发送上半部分（第 0 ~ 7 行）
    SSD13XX_WriteCommand(0xB0 | page);
    SSD13XX_WriteCommand(col & 0x0F);
    SSD13XX_WriteCommand(0x10 | (col >> 4));
    for (i = 0; i < 8; i++) {
      SSD13XX_WriteData(font[i]);
    }
    // 发送下半部分（第 8 ~ 15 行）
    SSD13XX_WriteCommand(0xB0 | (page + 1));
    SSD13XX_WriteCommand(col & 0x0F);
    SSD13XX_WriteCommand(0x10 | (col >> 4));
    for (i = 8; i < 16; i++) {
      SSD13XX_WriteData(font[i]);
    }
  }
}
// void SSD1315_WriteString(unsigned char x, unsigned char y, char *str,
// FontSize size) {

//     unsigned char cx = x, cy = y;
// 	if (size != FONT_8X8) return;
//     while (*str) {
//         if (cx + 8 > SSD1315_WIDTH) {
//             cx = 0;
//             cy += 8;
//             if (cy + 8 > SSD1315_HEIGHT) break;
//         }
//         SSD1315_WriteChar(cx, cy, *str, FONT_8X8);
//         cx += 8;
//         str++;
//     }
// }

/***************************************************************************************************
 * 函数名: SSD13XX_WriteString
 * 描述: 在指定位置显示字符串
 * 输入: x, y - 字符串显示起始坐标
 *       str - 要显示的字符串指针
 *       size - 字符大小(FONT_8X8或FONT_16X16)
 * 输出: 无
 * 返回: 无
 * 注意: 自动处理换行，支持8x8和16x16字体
 **************************************************************************************************/
void SSD13XX_WriteString(unsigned char x, unsigned char y, char *str,
                         FontSize size) {
  unsigned char cx = x, cy = y;
  unsigned char char_width = (size == FONT_8X8) ? 8 : 16;
  unsigned char char_height = (size == FONT_8X8) ? 8 : 16;

  if (y % 8 != 0)
    return; // 简化：要求起始坐标页对齐

  while (*str) {
    if (cx + char_width > SSD13XX_WIDTH) {
      cx = 0;
      cy += char_height;
      if (cy + char_height > SSD13XX_HEIGHT)
        break;
    }
    SSD13XX_WriteChar(cx, cy, *str, size);
    cx += char_width;
    str++;
  }
}

/***************************************************************************************************
 * 函数名: SSD13XX_Init
 * 描述: 初始化SSD13XX OLED显示屏
 * 输入: 无
 * 输出: 无
 * 返回: 无
 * 注意: 配置显示参数，设置默认显示模式
 **************************************************************************************************/
void SSD13XX_Init(void) {
  unsigned int i;
  I2C_Init();
  for (i = 0; i < 100; i++)
    I2C_Delay();

  SSD13XX_WriteCommand(SSD13XX_CMD_DISPLAY_OFF);
  SSD13XX_WriteCommand(SSD13XX_CMD_SET_DISPLAY_CLOCK_DIV);
  SSD13XX_WriteCommand(0x80);
  SSD13XX_WriteCommand(SSD13XX_CMD_SET_MULTIPLEX);
  SSD13XX_WriteCommand(SSD13XX_HEIGHT - 1);
  SSD13XX_WriteCommand(SSD13XX_CMD_SET_DISPLAY_OFFSET);
  SSD13XX_WriteCommand(0x00);
  SSD13XX_WriteCommand(SSD13XX_CMD_SET_START_LINE | 0x00);
  SSD13XX_WriteCommand(SSD13XX_CMD_CHARGE_PUMP);
  SSD13XX_WriteCommand(0x14);
  SSD13XX_WriteCommand(SSD13XX_CMD_MEMORY_MODE);
  SSD13XX_WriteCommand(0x00);
  SSD13XX_WriteCommand(SSD13XX_CMD_SEGREMAP);
  SSD13XX_WriteCommand(SSD13XX_CMD_COMSCAN_DEC);
  SSD13XX_WriteCommand(SSD13XX_CMD_SET_COMPINS);
  SSD13XX_WriteCommand(0x12);
  SSD13XX_WriteCommand(SSD13XX_CMD_SET_CONTRAST);
  SSD13XX_WriteCommand(0xCF);
  SSD13XX_WriteCommand(SSD13XX_CMD_SET_PRECHARGE);
  SSD13XX_WriteCommand(0xF1);
  SSD13XX_WriteCommand(SSD13XX_CMD_SET_VCOMDETECT);
  SSD13XX_WriteCommand(0x40);
  SSD13XX_WriteCommand(SSD13XX_CMD_DISPLAYALLON_RESUME);
  SSD13XX_WriteCommand(SSD13XX_CMD_NORMAL_DISPLAY);
  SSD13XX_WriteCommand(SSD13XX_CMD_DEACTIVATE_SCROLL);
  SSD13XX_WriteCommand(SSD13XX_CMD_DISPLAY_ON);

  I2C_Delay();
  SSD13XX_Clear();
}

/*固有组件*/
/**
 * @brief 绘制一个进度条组件（占用一个Page，高度8像素）
 * @param x        组件左上角X坐标（通常为0）
 * @param y        组件左上角Y坐标（必须是8的倍数）
 * @param width    组件总宽度（像素）
 * @param left_str 左侧显示的字符串（如 "CPU"）
 * @param right_str 右侧显示的字符串（如 "67%"），可为NULL
 * @param percent  进度百分比（0~100）
 */
void Draw_ProgressBar_Component(unsigned char x, unsigned char y,
                                unsigned char width, char *left_str,
                                char *right_str, unsigned char percent) {
  unsigned char left_width, right_width, remaining_width, fill_width;
  unsigned char bar_start_x, bar_end_x;
  unsigned char i;

  // 参数检查：y必须为8的倍数，否则文本无法显示
  if (y % 8 != 0)
    return;
  if (percent > 100)
    percent = 100;
  if (width < 20)
    return; // 太窄无法绘制

  // 计算左右文本占据的像素宽度（每个字符8像素）
  left_width = (left_str != NULL) ? (strlen(left_str) * 8) : 0;
  right_width = (right_str != NULL) ? (strlen(right_str) * 8) : 0;

  // 剩余宽度用于进度条（左右各留1像素边距）
  remaining_width = width - left_width - right_width - 2; // 减2是两侧留白
  if (remaining_width < 10)
    remaining_width = 10; // 最小宽度

  // 进度条填充宽度
  fill_width = (remaining_width * percent) / 100;
  if (fill_width < 0)
    fill_width = 0;
  if (fill_width > remaining_width)
    fill_width = remaining_width;

  // 计算进度条的起始和结束坐标
  bar_start_x = x + left_width + 1;        // 左侧文本后空1像素
  bar_end_x = x + width - right_width - 1; // 右侧文本前空1像素

  // 绘制进度条外框（高度4px，从 y+2 到 y+5）
  SSD13XX_DrawRectangle(bar_start_x, y + 2, bar_end_x, y + 5, 1);

  // 绘制填充部分（内部用横线填充，填充区域为 bar_start_x+1 到
  // bar_start_x+fill_width，行范围为 y+2+1 到 y+5-1）
  if (fill_width > 0) {
    for (i = y + 3; i <= y + 4;
         i++) { // 绘制两行横线，使4px高度有较好的填充效果
      SSD13XX_DrawLine(bar_start_x + 1, i, bar_start_x + fill_width, i, 1);
    }
  }

  if (left_str != NULL) {
    SSD13XX_WriteString(x, y, left_str, FONT_8X8);
  }

  if (right_str != NULL) {
    unsigned char right_text_x = x + width - right_width;
    SSD13XX_WriteString(right_text_x, y, right_str, FONT_8X8);
  }
}
// 测试

void SSD13XX_ShowAllChars(void) {
  unsigned char x, y;
  unsigned char ch;

  SSD13XX_Clear();

  for (ch = 32; ch <= 127; ch++) {

    x = (ch - 32) % 16 * 8;
    y = (ch - 32) / 16 * 8;
    SSD13XX_WriteChar(x, y, ch, FONT_8X8);
  }
}

/**
 * @brief 双行进度条组件（占用2个Page，高度16像素）
 * @param x         左上角X坐标（通常为0）
 * @param y         左上角Y坐标（必须是8的倍数）
 * @param width     组件总宽度（像素）
 * @param title     第一行左侧标题字符串
 * @param title_right 第一行右侧字符串（可为NULL）
 * @param label     第二行左侧标签（可为NULL）
 * @param percent   第二行右侧显示的百分比数值（0-100）
 */
void Draw_ProgressBar_Double(unsigned char x, unsigned char y,
                             unsigned char width, char *title,
                             char *title_right, char *label,
                             unsigned char percent) {
  unsigned char title_right_width, percent_str_width;
  unsigned char left_label_width;
  unsigned char bar_start_x, bar_end_x, bar_width, fill_width;
  unsigned char i;
  char percent_str[5];
  unsigned char second_y;

  // 必须页对齐
  if (y % 8 != 0)
    return;
  if (percent > 100)
    percent = 100;
  if (width < 30)
    return;

  // ========== 第一行（Page y/8）==========
  if (title != NULL) {
    SSD13XX_WriteString(x, y, title, FONT_8X8);
  }
  if (title_right != NULL) {
    title_right_width = strlen(title_right) * 8;
    SSD13XX_WriteString(x + width - title_right_width, y, title_right,
                        FONT_8X8);
  }

  // ========== 第二行（Page y/8 + 1）==========
  second_y = y + 8;

  // 左侧标签宽度
  left_label_width = (label != NULL) ? (strlen(label) * 8) : 0;
  if (label != NULL) {
    SSD13XX_WriteString(x, second_y, label, FONT_8X8);
  }

  // 生成百分比字符串
  if (percent >= 100) {
    percent_str[0] = '1';
    percent_str[1] = '0';
    percent_str[2] = '0';
    percent_str[3] = '%';
    percent_str[4] = '\0';
  } else if (percent >= 10) {
    percent_str[0] = (percent / 10) + '0';
    percent_str[1] = (percent % 10) + '0';
    percent_str[2] = '%';
    percent_str[3] = '\0';
  } else {
    percent_str[0] = (percent % 10) + '0';
    percent_str[1] = '%';
    percent_str[2] = '\0';
  }
  percent_str_width = strlen(percent_str) * 8;

  // 进度条左右边界（左右各留3像素边距，左对齐）
  bar_start_x = x + left_label_width + 3;
  bar_start_x = x + 3; // 紧贴左侧标签，空3像素
  bar_end_x =
      x + width - percent_str_width - 3; // 右侧紧贴百分比文本前，空3像素
  if (bar_end_x <= bar_start_x) {
    // 空间不足，不绘制进度条
    return;
  }
  bar_width = bar_end_x - bar_start_x; // 实际可用宽度

  fill_width = (bar_width * percent) / 100;
  if (fill_width > bar_width)
    fill_width = bar_width;
  if (fill_width < 0)
    fill_width = 0;

  // 绘制进度条外框（高度4px，位于第二行垂直居中：y+2 到 y+5）
  SSD13XX_DrawRectangle(bar_start_x, second_y + 2, bar_end_x, second_y + 5, 1);

  // 绘制填充部分（两行横线，使4px高度饱满）
  if (fill_width > 0) {
    for (i = second_y + 3; i <= second_y + 4; i++) {
      SSD13XX_DrawLine(bar_start_x + 1, i, bar_start_x + fill_width, i, 1);
    }
  }

  // 显示右侧百分比（右对齐，紧贴右边距3像素）
  if (percent_str[0] != '\0') {
    SSD13XX_WriteString(x + width - percent_str_width, second_y, percent_str,
                        FONT_8X8);
  }
}