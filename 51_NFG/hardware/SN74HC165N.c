#include "SN74HC165N.h"
#include "SN74HC595N.h"   /* 需要 SR595_PL165() */

/* 读取当前 OUT 引脚电平 (不产生 CLK) */
static u8 rd_pin(u8 v)
{
  return v ? 1 : 0;
}

static void clk_pulse(void)
{
  CLK165 = 0;
  CLK165 = 1;
}

/* =========================================================================
 *  初始化: 引脚准备 (CLK 置低, OUT 引脚设为输入)
 *  STC90C58 的 P1/P2 上电默认为准双向口, 读取前先写 1 即可当输入使用。
 * ========================================================================= */
void init_SN74HC165N(void)
{
  CLK165    = 0;

  DQ_CTL_OUT = 1;   /* 准双向口, 置 1 作为输入 */
  AL_CTL_OUT = 1;
  AR_CTL_SER = 1;
}

/* =========================================================================
 *  PL 装载: 拉低装入并行数据, 再拉高进入移位模式
 *  三片 165 的 PL 共用, 由 595-CTL 的 QD 控制。
 * ========================================================================= */
void SR165_Load(void)
{
  SR595_PL165(0);   /* PL = 0, 并行装入 */
  /* 短延时确保装载完成 (此处用空操作, 时钟很慢足够) */
  SR595_PL165(1);   /* PL = 1, 进入移位 */
}

/* 读一位: 先读 OUT, 再 CLK 脉冲 */
u8 SR165_ShiftReadBit(void)
{
  u8 b;
  b = rd_pin(DQ_CTL_OUT);
  clk_pulse();
  return b;
}

/* =========================================================================
 *  读取 165-DQ 的 8 位 (DQ0-DQ7)
 *  165 移位输出顺序: 先出 H 位(D7) 还是 QA(D0) 取决于芯片 QH 接法。
 *  下面按"先出最高位 D7, 最后出 D0"的常见顺序组装 (QA->D0 ... QH->D7)。
 *  若实际接线相反, 只需把循环里的移位方向改成左移即可。
 * ========================================================================= */
u8 SR165_DQ_Read(void)
{
  u8 i;
  u8 dat = 0;

  SR165_Load();                 /* 装载并行数据 */

  for (i = 0; i < 8; i++) {
    dat <<= 1;                  /* 先收到的位放在高位 */
    dat |= rd_pin(DQ_CTL_OUT);
    clk_pulse();
  }
  return dat;
}

/* =========================================================================
 *  读取 165-A12 两片级联的地址 (A0-A12)
 *
 *  两片 165 级联: 前级(AR)的 QH 串入末级(AL)的 SER;
 *  末级(AL) 的 QH 作为整链输出, 接到 MCU 的 AL_CTL_OUT。
 *  因此数据先经末级输出: 先读到的是"前级(AR)的 8 位 A0-A7",
 *  之后继续读到"末级(AL)的 A8-A12"。
 *  这里读 16 位(两片满) 再取低/高部分, 低 13 位有效 -> A0-A12。
 * ========================================================================= */
u16 SR165_A12_Read(void)
{
  u8  i;
  u16 dat = 0;

  SR165_Load();                 /* 装载并行数据 */

  /* 前级 8 位 (A0-A7) 先出 */
  for (i = 0; i < 8; i++) {
    dat <<= 1;
    dat |= rd_pin(AL_CTL_OUT);
    clk_pulse();
  }
  /* 末级 8 位 (其中 A8-A12 有效) 再出 */
  for (i = 0; i < 8; i++) {
    dat <<= 1;
    dat |= rd_pin(AL_CTL_OUT);
    clk_pulse();
  }
  return dat;
}

/* =========================================================================
 *  统一接口
 * ========================================================================= */
u16 SR165_Read(u8 chip)
{
  switch (chip) {
    case SR165_DQ:
      return (u16)SR165_DQ_Read();
    case SR165_A12:
      return SR165_A12_Read();
    default:
      return 0;
  }
}


