#include "12864G.h"

/*============================================================================
  字库点阵数据（原 8051 中用 code 关键字存放于程序存储器，
  STM32 中用 const 存放于 Flash）
============================================================================*/
/*--  文字:  囧  宋体12  宽x高=16x16  --*/
const uchar jiong1[] = {
0x00,0xFE,0x82,0x42,0xA2,0x9E,0x8A,0x82,0x86,0x8A,0xB2,0x62,0x02,0xFE,0x00,0x00,
0x00,0x7F,0x40,0x40,0x7F,0x40,0x40,0x40,0x40,0x40,0x7F,0x40,0x40,0x7F,0x00,0x00};

/*--  文字:  畾  宋体12  宽x高=16x16  --*/
const uchar lei1[] = {
0x80,0x80,0x80,0xBF,0xA5,0xA5,0xA5,0x3F,0xA5,0xA5,0xA5,0xBF,0x80,0x80,0x80,0x00,
0x7F,0x24,0x24,0x3F,0x24,0x24,0x7F,0x00,0x7F,0x24,0x24,0x3F,0x24,0x24,0x7F,0x00};

/*============================================================================
  GPIO 初始化
============================================================================*/
void LCD_GPIO_Init(void)
{
    GPIO_InitTypeDef GPIO_InitStructure;

    /* 使能 GPIOA、GPIOB 时钟 */
    RCC_APB2PeriphClockCmd(RCC_APB2Periph_GPIOA | RCC_APB2Periph_GPIOB, ENABLE);

    /* LCD 引脚：推挽输出 */
    GPIO_InitStructure.GPIO_Mode  = GPIO_Mode_Out_PP;
    GPIO_InitStructure.GPIO_Speed = GPIO_Speed_50MHz;
    GPIO_InitStructure.GPIO_Pin   = LCD_SCLK_PIN | LCD_SID_PIN | LCD_RS_PIN |
                                    LCD_RESET_PIN | LCD_CS1_PIN;
    GPIO_Init(LCD_SCLK_PORT, &GPIO_InitStructure);

    /* 字库IC输出引脚：推挽输出 */
    GPIO_InitStructure.GPIO_Pin = ROM_IN_PIN | ROM_SCK_PIN | ROM_CS_PIN;
    GPIO_Init(ROM_IN_PORT, &GPIO_InitStructure);

    /* 字库IC数据输出引脚（ROM_OUT）：浮空输入 */
    GPIO_InitStructure.GPIO_Mode = GPIO_Mode_IN_FLOATING;
    GPIO_InitStructure.GPIO_Pin  = ROM_OUT_PIN;
    GPIO_Init(ROM_OUT_PORT, &GPIO_InitStructure);

    /* 初始电平：CS1=1, CS=1, SCLK=0 */
    LCD_CS1_H();
    ROM_CS_H();
    LCD_SCLK_L();
    ROM_SCK_L();
}

/*============================================================================
  写指令到 LCD 模块（软件 SPI，MSB first）
  注：原 8051 代码中 transfer_command_lcd 的 for 循环体为空，属排版错误，
      此处参照 transfer_data_lcd 的正确实现修正。
============================================================================*/
void Transfer_Command_LCD(uchar data1)
{
    char i;
    LCD_CS1_L();          /* 片选有效 */
    LCD_RS_L();           /* RS=0：指令 */
    for(i = 0; i < 8; i++)
    {
        LCD_SCLK_L();
        if(data1 & 0x80) LCD_SID_H();
        else             LCD_SID_L();
        LCD_SCLK_H();     /* 上升沿采样 */
        data1 <<= 1;
    }
    LCD_CS1_H();          /* 片选无效 */
}

/*============================================================================
  写数据到 LCD 模块
============================================================================*/
void Transfer_Data_LCD(uchar data1)
{
    char i;
    LCD_CS1_L();
    LCD_RS_H();           /* RS=1：数据 */
    for(i = 0; i < 8; i++)
    {
        LCD_SCLK_L();
        if(data1 & 0x80) LCD_SID_H();
        else             LCD_SID_L();
        LCD_SCLK_H();
        data1 <<= 1;
    }
    LCD_CS1_H();
}

/*============================================================================
  LCD 模块初始化（UC1701X / ST7565R 兼容）
============================================================================*/
void LCD_Init(void)
{
    LCD_GPIO_Init();

    LCD_RESET_L();        /* 低电平复位 */
    Delay_ms(100);
    LCD_RESET_H();        /* 复位完毕 */
    Delay_ms(100);

    Transfer_Command_LCD(0xE2);  /* 软复位 */
    Delay_ms(5);
    Transfer_Command_LCD(0x2C);  /* 升压步骤 1 */
    Delay_ms(50);
    Transfer_Command_LCD(0x2E);  /* 升压步骤 2 */
    Delay_ms(50);
    Transfer_Command_LCD(0x2F);  /* 升压步骤 3 */
    Delay_ms(5);
    Transfer_Command_LCD(0x23);  /* 粗调对比度 0x20~0x27 */
    Transfer_Command_LCD(0x81);  /* 微调对比度 */
    Transfer_Command_LCD(0x28);  /* 微调对比度值 0x00~0x3F */
    Transfer_Command_LCD(0xA2);  /* 1/9 偏压比 (bias) */
    Transfer_Command_LCD(0xC8);  /* 行扫描顺序：从上到下 */
    Transfer_Command_LCD(0xA0);  /* 列扫描顺序：从左到右 */
    Transfer_Command_LCD(0x40);  /* 起始行：第一行开始 */
    Transfer_Command_LCD(0xAF);  /* 开显示 */
}

/*============================================================================
  设置 LCD 页地址和列地址
  page: 1~8（每8行为一页，64行共8页）
  column: 1~128
============================================================================*/
void LCD_Address(uint page, uint column)
{
    column = column - 0x01;
    Transfer_Command_LCD(0xB0 + page - 1);                  /* 设置页地址 */
    Transfer_Command_LCD(0x10 + ((column >> 4) & 0x0F));    /* 列地址高4位 */
    Transfer_Command_LCD(column & 0x0F);                    /* 列地址低4位 */
}

/*============================================================================
  全屏清屏
============================================================================*/
void LCD_Clear(void)
{
    unsigned char i, j;
    for(i = 0; i < 8; i++)
    {
        Transfer_Command_LCD(0xB0 + i);
        Transfer_Command_LCD(0x10);
        Transfer_Command_LCD(0x00);
        for(j = 0; j < 132; j++)
        {
            Transfer_Data_LCD(0x00);
        }
    }
}

/*============================================================================
  显示 128x64 点阵图像
============================================================================*/
void Display_128x64(const uchar *dp)
{
    uint i, j;
    for(j = 0; j < 8; j++)
    {
        LCD_Address(j + 1, 1);
        for(i = 0; i < 128; i++)
        {
            Transfer_Data_LCD(*dp);
            dp++;
        }
    }
}

/*============================================================================
  显示 16x16 点阵图像、汉字、生僻字或图标
============================================================================*/
void Display_Graphic_16x16(uchar page, uchar column, const uchar *dp)
{
    uint i, j;
    for(j = 0; j < 2; j++)
    {
        LCD_Address(page + j, column);
        for(i = 0; i < 16; i++)
        {
            Transfer_Data_LCD(*dp);
            dp++;
        }
    }
}

/*============================================================================
  显示 8x16 点阵图像、ASCII 或自造字符
============================================================================*/
void Display_Graphic_8x16(uchar page, uchar column, const uchar *dp)
{
    uint i, j;
    for(j = 0; j < 2; j++)
    {
        LCD_Address(page + j, column);
        for(i = 0; i < 8; i++)
        {
            Transfer_Data_LCD(*dp);
            dp++;
        }
    }
}

/*============================================================================
  显示 5x8 点阵图像、ASCII 或自造字符
============================================================================*/
void Display_Graphic_5x8(uchar page, uchar column, const uchar *dp)
{
    uint i;
    LCD_Address(page, column);
    for(i = 0; i < 6; i++)
    {
        Transfer_Data_LCD(*dp);
        dp++;
    }
}

/*============================================================================
  送指令到晶联讯字库 IC（JLX-GB2312）
============================================================================*/
void Send_Command_To_ROM(uchar datu)
{
    uchar i;
    for(i = 0; i < 8; i++)
    {
        ROM_SCK_L();
        Delay_us(10);
        if(datu & 0x80) ROM_IN_H();
        else            ROM_IN_L();
        datu <<= 1;
        ROM_SCK_H();
        Delay_us(10);
    }
}

/*============================================================================
  从晶联讯字库 IC 中读取 1 个字节数据
============================================================================*/
uchar Get_Data_From_ROM(void)
{
    uchar i;
    uchar ret_data = 0;
    for(i = 0; i < 8; i++)
    {
        ROM_SCK_L();
        ret_data <<= 1;
        if(ROM_OUT_READ())
            ret_data |= 1;
        ROM_SCK_H();
    }
    return ret_data;
}

/*============================================================================
  从指定地址读出 16x16 点阵数据写到液晶屏指定坐标
============================================================================*/
void Get_And_Write_16x16(ulong fontaddr, uchar page, uchar column)
{
    uchar i, j, disp_data;
    ROM_CS_L();
    Send_Command_To_ROM(0x03);                              /* 读命令 */
    Send_Command_To_ROM((fontaddr & 0xFF0000) >> 16);       /* 地址高8位 */
    Send_Command_To_ROM((fontaddr & 0xFF00) >> 8);          /* 地址中8位 */
    Send_Command_To_ROM(fontaddr & 0xFF);                   /* 地址低8位 */
    for(j = 0; j < 2; j++)
    {
        LCD_Address(page + j, column);
        for(i = 0; i < 16; i++)
        {
            disp_data = Get_Data_From_ROM();
            Transfer_Data_LCD(disp_data);
        }
    }
    ROM_CS_H();
}

/*============================================================================
  从指定地址读出 8x16 点阵数据写到液晶屏指定坐标
============================================================================*/
void Get_And_Write_8x16(ulong fontaddr, uchar page, uchar column)
{
    uchar i, j, disp_data;
    ROM_CS_L();
    Send_Command_To_ROM(0x03);
    Send_Command_To_ROM((fontaddr & 0xFF0000) >> 16);
    Send_Command_To_ROM((fontaddr & 0xFF00) >> 8);
    Send_Command_To_ROM(fontaddr & 0xFF);
    for(j = 0; j < 2; j++)
    {
        LCD_Address(page + j, column);
        for(i = 0; i < 8; i++)
        {
            disp_data = Get_Data_From_ROM();
            Transfer_Data_LCD(disp_data);
        }
    }
    ROM_CS_H();
}

/*============================================================================
  从指定地址读出 5x8 点阵数据写到液晶屏指定坐标
============================================================================*/
void Get_And_Write_5x8(ulong fontaddr, uchar page, uchar column)
{
    uchar i, disp_data;
    ROM_CS_L();
    Send_Command_To_ROM(0x03);
    Send_Command_To_ROM((fontaddr & 0xFF0000) >> 16);
    Send_Command_To_ROM((fontaddr & 0xFF00) >> 8);
    Send_Command_To_ROM(fontaddr & 0xFF);
    LCD_Address(page, column);
    for(i = 0; i < 5; i++)
    {
        disp_data = Get_Data_From_ROM();
        Transfer_Data_LCD(disp_data);
    }
    ROM_CS_H();
}

/*============================================================================
  显示 GB2312 字符串（16x16 汉字 / 8x16 ASCII）
============================================================================*/
ulong fontaddr = 0;

void Display_GB2312_String(uchar page, uchar column, uchar *text)
{
    uchar i = 0;
    while(text[i] > 0x00)
    {
        /* GB2312 简体汉字：0xB0A1 ~ 0xF7FE */
        if(((text[i] >= 0xB0) && (text[i] <= 0xF7)) && (text[i+1] >= 0xA1))
        {
            fontaddr  = (text[i] - 0xB0) * 94;
            fontaddr += (text[i+1] - 0xA1) + 846;
            fontaddr  = (ulong)(fontaddr * 32);
            Get_And_Write_16x16(fontaddr, page, column);
            i += 2;
            column += 16;
        }
        /* GB2312 15x16 字符：0xA1A1 ~ 0xA3FE */
        else if(((text[i] >= 0xA1) && (text[i] <= 0xA3)) && (text[i+1] >= 0xA1))
        {
            fontaddr  = (text[i] - 0xA1) * 94;
            fontaddr += (text[i+1] - 0xA1);
            fontaddr  = (ulong)(fontaddr * 32);
            Get_And_Write_16x16(fontaddr, page, column);
            i += 2;
            column += 16;
        }
        /* ASCII：0x20 ~ 0x7E（8x16 点阵） */
        else if((text[i] >= 0x20) && (text[i] <= 0x7E))
        {
            fontaddr = (text[i] - 0x20);
            fontaddr = (ulong)(fontaddr * 16);
            fontaddr = (ulong)(fontaddr + 0x3CF80);
            Get_And_Write_8x16(fontaddr, page, column);
            i += 1;
            column += 8;
        }
        else
            i++;
    }
}

/*============================================================================
  显示 5x8 点阵 ASCII 字符串
============================================================================*/
void Display_String_5x8(uchar page, uchar column, uchar *text)
{
    uchar i = 0;
    while(text[i] > 0x00)
    {
        if((text[i] >= 0x20) && (text[i] <= 0x7E))
        {
            fontaddr = (text[i] - 0x20);
            fontaddr = (ulong)(fontaddr * 8);
            fontaddr = (ulong)(fontaddr + 0x3BFC0);
            Get_And_Write_5x8(fontaddr, page, column);
            i += 1;
            column += 6;
        }
        else
            i++;
    }
}

/*============================================================================
  128x64 点阵图像数据（原 8051 bmp1）
  宽度x高度=128x64
============================================================================*/
const uchar bmp1[] = {
0x00,0x00,0x00,0x00,0x00,0x00,0x00,0x00,0x00,0x00,0x00,0x00,0x00,0x00,0x00,0x00,
0x00,0x00,0x00,0x80,0x80,0xC0,0xC0,0xC0,0xC0,0xE0,0x60,0xE0,0xE0,0xE0,0xE0,0x60,
0x60,0x60,0x60,0x60,0x60,0x60,0xE0,0xE0,0xE0,0xE0,0xC0,0xC0,0xC0,0xC0,0x80,0x80,
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0x00,0x00,0x00,0x00,0x00,0x00,0x00,0x00,0x00,0x00,0x00,0x00,0x00,0x00,0x00,0x00,
};